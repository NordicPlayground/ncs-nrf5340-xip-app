## Kconfig
```kconfig
#
# Copyright (c) 2023 Nordic Semiconductor ASA
#
# SPDX-License-Identifier: LicenseRef-Nordic-5-Clause
#

config XIP_SPLIT_IMAGE
	bool "Split XIP image"
	depends on SOC_NRF5340_CPUAPP
	depends on !MCUBOOT
	help
	  Allows for an image to be split into 2 parts where there is code executing from internal
	  flash and code from QSPI via XIP. Requires specific project setup for projects to use
	  this feature.
```

## west.yml
```yaml
# Copyright (c) 2023 Nordic Semiconductor ASA
# SPDX-License-Identifier: Apache-2.0

manifest:
  self:
    west-commands: scripts/west-commands.yml

  remotes:
    - name: ncs
      url-base: https://github.com/nrfconnect

  projects:
    - name: nrf
      remote: ncs
      repo-path: sdk-nrf
      revision: e1dca3bad5c87eff7a9ad5ee8a3d5f29e7acfdb0
      import: true

  self:
    path: nrf5340_qspi_xip_manifest
```
